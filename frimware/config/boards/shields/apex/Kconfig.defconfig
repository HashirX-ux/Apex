## frimware/config/boards/shields/apex/Kconfig.defconfig
```kconfig
if SHIELD_APEX

config ZMK_KEYBOARD_NAME
    default "Apex"

config ZMK_USB
    default y

config ZMK_BLE
    default y

config ZMK_EXT_POWER
    default y

endif
```
